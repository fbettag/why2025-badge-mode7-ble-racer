## sdkconfig.defaults
```kconfig
# ESP32-P4 Configuration for Mode-7 BLE Racer
CONFIG_IDF_TARGET="esp32p4"

# Memory configuration
CONFIG_ESP_PSRAM=y
CONFIG_SPIRAM_MODE_OCT=y
CONFIG_SPIRAM_SPEED_80M=y
CONFIG_SPIRAM_IGNORE_NOTFOUND=y

# Display configuration
CONFIG_LCD_ENABLED=y
CONFIG_LCD_RGB_PANEL=y
CONFIG_LCD_RGB_ISR_IRAM_SAFE=y

# 2D-DMA configuration
CONFIG_GDMA_ENABLED=y
CONFIG_GDMA_CTRL_FUNC_IN_IRAM=y

# SPI configuration
CONFIG_SPI_MASTER_ISR_IN_IRAM=y
CONFIG_SPI_SLAVE_ISR_IN_IRAM=y

# I2C for IMU
CONFIG_I2C_ENABLED=y

# BLE configuration (for C6 coordination)
CONFIG_BT_ENABLED=y
CONFIG_BT_NIMBLE_ENABLED=y
CONFIG_BT_NIMBLE_MEM_ALLOC_MODE_DEFAULT=y
CONFIG_BT_NIMBLE_MAX_CONNECTIONS=2
CONFIG_BT_NIMBLE_MAX_BONDS=4
CONFIG_BT_NIMBLE_MAX_CCCDS=8
CONFIG_BT_NIMBLE_SVC_GAP_DEVICE_NAME="Mode7Racer"
CONFIG_BT_NIMBLE_ROLE_CENTRAL=y
CONFIG_BT_NIMBLE_ROLE_PERIPHERAL=y
CONFIG_BT_NIMBLE_ROLE_BROADCASTER=y
CONFIG_BT_NIMBLE_ROLE_OBSERVER=y
CONFIG_BT_NIMBLE_GAP_DEVICE_NAME_MAX_LEN=32
CONFIG_BT_NIMBLE_ATT_PREFERRED_MTU=256
CONFIG_BT_NIMBLE_ACL_BUF_COUNT=24
CONFIG_BT_NIMBLE_ACL_BUF_SIZE=255

# Logging
CONFIG_LOG_DEFAULT_LEVEL_INFO=y
CONFIG_LOG_COLORS=y

# Performance optimizations
CONFIG_ESP_SYSTEM_PANIC_PRINT_HALT=y
CONFIG_ESP_MAIN_TASK_STACK_SIZE=8192
CONFIG_ESP_MINIMAL_SHARED_STACK_SIZE=2048
```
